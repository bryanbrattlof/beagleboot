// SPDX-License-Identifier: GPL-2.0-only OR MIT
/*
 * Copyright (C) 2026 Texas Instruments Incorporated - https://www.ti.com/
 */

#include "k3-am62l3-evm-binman.dtsi"

/ {
	aliases {
		mmc1 = &sdhci1;
	};
};
